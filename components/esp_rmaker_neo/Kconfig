## components/osal/mqtt/test-mqtt-common/Kconfig
```kconfig
menu "(test-mqtt-common) MQTT Common Test Configuration"
    config TEST_MQTT_COMMON_BROKER_URI
        string "MQTT Broker URL"
        default "localhost"
        help
            The MQTT broker to connect to. It should have 3 ports for TCP with username/password
            authentication, TLS (server side only), and TLS (mutual authentication).

    config TEST_MQTT_COMMON_TCP_USERNAME
        string "(TCP) Username"
        default "username"
        help
            The username to use when connecting over TCP.

    config TEST_MQTT_COMMON_TCP_PASSWORD
        string "(TCP) Password"
        default "password"
        help
            The password to use when connecting over TCP.

    config TEST_MQTT_COMMON_PORT_TCP
        int "TCP port"
        default 1883
        help
            Broker port for TCP with username/password authentication.

    config TEST_MQTT_COMMON_PORT_TLS_SERVER_ONLY
        int "TLS port (server side only)"
        default 8883
        help
            Broker port for TLS (server side only).

    config TEST_MQTT_COMMON_PORT_TLS_MUTUAL_AUTH
        int "TLS port (mutual authentication)"
        default 8884
        help
            Broker port for TLS (mutual authentication).
endmenu
```

## examples/common/app_button/Kconfig.projbuild
```kconfig
menu "ESP RainMaker App Button Configuration"

    config APP_BUTTON_GPIO_NUM
        int "GPIO pin"
        default 28 if IDF_TARGET_ESP32C5
        default 9 if IDF_TARGET_ESP32C3 || IDF_TARGET_ESP32C6 || IDF_TARGET_ESP32C2 || IDF_TARGET_ESP32H2
        default 0
        help
            GPIO pin to use as button input. Defaults to the BOOT button on most boards.

    config APP_BUTTON_IS_ACTIVE_HIGH
        bool "Is active HIGH?"
        default n
        help
            True: active HIGH, False: active LOW

    config APP_BUTTON_SHORT_PRESS_TIME_MS
        int "Short press time (ms)"
        default 50
        help
            Time in milliseconds for the button to be pressed before performing the action.

    config APP_BUTTON_LONG_PRESS_TIME_MS
        int "Long press time (ms)"
        default 1000
        help
            Time in milliseconds for the button to be pressed and held down before performing the long press action.

endmenu
```

## examples/common/app_led/Kconfig.projbuild
```kconfig
menu "ESP RainMaker App LED Configuration"

    choice APP_LED_TYPE
        prompt "LED type"
        default APP_LED_TYPE_LEDC if IDF_TARGET_ESP32C2
        default APP_LED_TYPE_WS2812
        help
            The protocol used by the LED connected to the project.

        config APP_LED_TYPE_WS2812
            bool "WS2812 LED strip"
            help
                Controlled by a single GPIO pin.

        config APP_LED_TYPE_LEDC
            bool "LEDC"
            help
                Controlled by R, G, B GPIO pins.

    endchoice

    menu "WS2812 Configuration"
        depends on APP_LED_TYPE_WS2812

        config APP_LED_WS2812_GPIO_NUM
            int "GPIO pin"
            default 27 if IDF_TARGET_ESP32C5
            default 8 if IDF_TARGET_ESP32C3 || IDF_TARGET_ESP32C6 || IDF_TARGET_ESP32H2
            default 48 if IDF_TARGET_ESP32S3
            default 18
    endmenu

    menu "LEDC Configuration"
        depends on APP_LED_TYPE_LEDC

        config APP_LED_LEDC_GPIO_NUM_R
            int "GPIO pin (red channel)"
            default 0
        config APP_LED_LEDC_GPIO_NUM_G
            int "GPIO pin (green channel)"
            default 1
        config APP_LED_LEDC_GPIO_NUM_B
            int "GPIO pin (blue channel)"
            default 8
    endmenu
endmenu
```

## examples/common/app_network/Kconfig.projbuild
```kconfig
menu "ESP RainMaker Neo App Network Configuration"
    choice APP_NETWORK_PROTOCOL_TYPE
        prompt "ESP RainMaker Neo Network Type"
        default APP_NETWORK_OVER_WIFI
        help
            Network protocol type over which the app will run.

        config APP_NETWORK_OVER_WIFI
            depends on ESP_WIFI_ENABLED
            bool "ESP RainMaker Neo over Wi-Fi"

        config APP_NETWORK_OVER_THREAD
            depends on OPENTHREAD_ENABLED
            bool "ESP RainMaker Neo over Thread"
    endchoice

    config APP_NETWORK_OVER_THREAD_IPV4_NETWORKING
        depends on APP_NETWORK_OVER_THREAD
        bool "Enable IPv4 networking for Thread"
        default y
        select OPENTHREAD_DNS64_CLIENT
        help
            Enable IPv4 networking for Thread. This enables OPENTHREAD_DNS64_CLIENT.

    config APP_NETWORK_OVER_THREAD_IPV4_NETWORKING_WARNING
        depends on APP_NETWORK_OVER_THREAD_IPV4_NETWORKING && OPENTHREAD_DNS64_CLIENT && \
            !LWIP_HOOK_DNS_EXT_RESOLVE_CUSTOM
        bool "⚠ Set LWIP_HOOK_DNS_EXT_RESOLVE_CUSTOM to y if you want to use IPv4 networking for Thread ⚠"
        default n
        help
            WARNING: OPENTHREAD_DNS64_CLIENT is enabled, but LWIP_HOOK_DNS_EXT_RESOLVE_CUSTOM is not set to y.
            This will cause IPv4 networking for Thread to not work.
            Set LWIP_HOOK_DNS_EXT_RESOLVE_CUSTOM to y if you want to use IPv4 networking for Thread.

    config APP_NETWORK_PROV_CONSOLE_CMD
        bool "Enable the provisioning console command"
        depends on ESP_RMAKER_NEO_CONSOLE_ENABLE
        default y
        help
            Register a console command that provisions the node from the serial console, without a
            phone app: `wifi-prov <ssid> [<passphrase>]` on Wi-Fi builds, `thread-prov
            <dataset_tlvs_hex>` on Thread builds.

            While a provisioning session is running, the credentials are handed to the provisioning
            manager. Once the node is provisioned, they are applied to the network stack directly.

    choice APP_NETWORK_POP_TYPE
        prompt "Proof of Possession Type"
        default APP_NETWORK_POP_TYPE_RANDOM
        help
            The type of Proof of Possession (PoP) to use.

        config APP_NETWORK_POP_TYPE_MAC
            bool "MAC address"
            help
                Use the MAC address as the PoP.

        config APP_NETWORK_POP_TYPE_RANDOM
            bool "Random"
            help
                Use a random PoP.

        config APP_NETWORK_POP_TYPE_NONE
            bool "None"
            help
                Use no PoP.

    endchoice

endmenu
```

## examples/common/app_reset/Kconfig.projbuild
```kconfig
menu "ESP RainMaker App Reset Configuration"

    config APP_RESET_ENABLED
        bool "Enable button resets"
        default y
        help
            Enable hold-to-reset on the application button.
            The button can be held down for a long time to perform a network reset, or an even longer time to
            perform a factory reset.

    menu "Button Reset Configuration"
        depends on APP_RESET_ENABLED

        config APP_RESET_NETWORK_TIME_MS
            int "Network reset time (ms)"
            default 5000
            range 1000 10000
            help
                Time in milliseconds for the button to be held down before performing the network reset.

                Set this above the button's own long-press time, so a long press and a network
                reset stay distinguishable. The bound is a literal rather than a reference to the
                button component's option, so this component can be used without it.

        config APP_RESET_FACTORY_TIME_MS
            int "Factory reset time (ms)"
            default 10000
            range APP_RESET_NETWORK_TIME_MS 20000
            help
                Time in milliseconds for the button to be held down before performing the factory reset.
                Must be greater than the network reset time.

        config APP_RESET_REBOOT_S
            int "Reboot time (s)"
            default 2
            range 0 10
            help
                Time in seconds to reboot the system after performing a reset action.

    endmenu

endmenu
```

## examples/switch/main/Kconfig.projbuild
```kconfig
menu "Switch Example Configuration"

    config SWITCH_NOTIFY_ON_PUSH_BTN_CB
        bool "Notify on button press"
        default n
        help
            Send a notification every time the button is pressed.
endmenu
```
