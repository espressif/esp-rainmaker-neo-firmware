## components/osal/Kconfig
```kconfig
# osal component Kconfig.
# (platform/Kconfig.posix is POSIX-only and registered separately via kconfig_reg.cmake;
# ESP-IDF must not see it.)

menu "OSAL Platform Build Options"

    config OSAL_USING_VIRTUAL_SCHEDULER
        bool "Use virtual scheduler"
        default n
        help
            If set to true, then the virtual scheduler is used in place of the implementation set in
            OSAL_TIMER_IMPL.

    menu "Virtual Scheduler Configuration"
        depends on OSAL_USING_VIRTUAL_SCHEDULER

        config OSAL_VIRTUAL_SCHEDULER_RESOLUTION_MS
            int "Resolution (ms)"
            default 50
            range 10 100
            help
                Resolution of the virtual scheduler in milliseconds.
                This is the time between each scheduler loop, where due times are checked and tasks are executed.

        config OSAL_VIRTUAL_SCHEDULER_EXECUTIONS_MAX
            int "Executions max"
            default 10
            range 1 100
            help
                Maximum number of executions to perform for a task in a single iteration.
                This is to prevent a periodic task from having too many executions due to time advancement.

        config OSAL_VIRTUAL_SCHEDULER_TASK_STACK_SIZE
            int "Task stack size"
            default 3172
            range 2048 4096
            help
                Stack size of the underlying task used by the virtual scheduler.

        config OSAL_VIRTUAL_SCHEDULER_TASK_PRIORITY
            int "Task priority"
            default 1
            range 1 10
            help
                Priority of the underlying task used by the virtual scheduler.

    endmenu

    choice OSAL_TIMER_IMPL
        depends on IDF_CMAKE
        bool "Timer implementation (ESP-IDF)"
        default OSAL_TIMER_IMPL_FREERTOS

        config OSAL_TIMER_IMPL_ESP
            bool "esp_timer"
            help
                Use esp_timer. Use only if high timing precision is required, since other system peripherals
                (e.g., Wi-Fi) also depend on this timer.

        config OSAL_TIMER_IMPL_FREERTOS
            bool "FreeRTOS software timers"
            help
                Use FreeRTOS software timers. Timing precision depends on the FreeRTOS ticks to Hz setting.

    endchoice

    menu "FreeRTOS Timer Configuration"
        depends on OSAL_TIMER_IMPL_FREERTOS && !OSAL_USING_VIRTUAL_SCHEDULER

        config OSAL_TIMER_FREERTOS_DISPATCH_TASK_STACK_SIZE
            int "Dispatch task stack size"
            default 3072
            range 3072 8192
            help
                Stack size of the task that runs the scheduled tasks. The FreeRTOS timer task only queues the
                expired timers for this task, so it does not need a larger stack.

        config OSAL_TIMER_FREERTOS_DISPATCH_TASK_PRIORITY
            int "Dispatch task priority"
            default FREERTOS_TIMER_TASK_PRIORITY
            range 1 24
            help
                Priority of the task that runs the scheduled tasks.

        config OSAL_TIMER_FREERTOS_CATCH_UP_MAX
            int "Catch-up executions max"
            default 10
            range 1 100
            help
                Maximum number of executions of a periodic task that the dispatch task runs together, when it
                runs late and the timer expired more than once.

    endmenu

endmenu

menu "OSAL Timesync Configuration"

    config OSAL_TIMESYNC_DEFAULT_TZ
        string "Default timezone"
        default "Asia/Shanghai"
        help
            Default timezone used.

endmenu

menu "OSAL HTTP Interface"

    config OSAL_HTTP_FORCE_USE_CERTIFICATE_BUNDLE
        bool
        default y
        select MBEDTLS_CERTIFICATE_BUNDLE if IDF_CMAKE
        help
            Force the use of the certificate bundle (ESP: esp_crt_bundle; POSIX: ca-bundle-posix).

    config OSAL_HTTP_BUFFER_SIZE
        int "HTTP buffer size"
        default 4096
        help
            Buffer size for HTTP operations.

    config OSAL_HTTP_TIMEOUT_MS
        int "HTTP timeout (ms)"
        default 30000
        help
            Timeout for HTTP operations in milliseconds.

endmenu

menu "OSAL Discovery Interface"

    choice OSAL_DISCOVERY_TYPE
        bool "Discovery type"
        default OSAL_DISCOVERY_TYPE_SRP if OPENTHREAD_ENABLED
        default OSAL_DISCOVERY_TYPE_MDNS

        config OSAL_DISCOVERY_TYPE_MDNS
            bool "mDNS (Wi-Fi)"
            help
                Advertise services via mDNS on Wi-Fi.

        config OSAL_DISCOVERY_TYPE_SRP
            bool "SRP (Thread)"
            depends on OPENTHREAD_ENABLED
            help
                Advertise services via SRP on Thread.

    endchoice

endmenu

menu "OSAL Optional Features"

    config OSAL_INCLUDE_EXT_IO
        bool "Include ext-io (serial I/O driver)"
        default n
        help
            Build the osal ext-io area (UART/PTY external I/O used by host_ctrl).

    config OSAL_INCLUDE_HEAP_MONITOR
        bool "Include heap monitor"
        default n
        select HEAP_PLACE_FUNCTION_INTO_FLASH
        help
            Build the osal heap-monitor area.

    config OSAL_INCLUDE_HTTP
        bool "Include HTTP client"
        default n
        help
            Build the osal http area (esp_http_client / libcurl backed).

endmenu

# MQTT client configuration
rsource "mqtt/Kconfig.mqtt" # codespell:ignore rsource

# External serial I/O (UART on ESP-IDF; symbols are ESP-only, the POSIX PTY impl needs no config)
rsource "ext-io/Kconfig.ext_io" # codespell:ignore rsource
```

## components/osal/ca-bundle/Kconfig
```kconfig
menu "CA Bundle (POSIX)"

    config OSAL_CA_BUNDLE_CUSTOM_CERTIFICATE_BUNDLE
        bool "Add custom certificates to the certificate bundle"
        default n
        help
            Add custom certificates to the CA bundle used for TLS on POSIX.
            The default bundle is the ESP-IDF CA bundle; this option appends
            the given file (PEM) to it.

    config OSAL_CA_BUNDLE_CUSTOM_CERTIFICATE_BUNDLE_PATH
        depends on OSAL_CA_BUNDLE_CUSTOM_CERTIFICATE_BUNDLE
        string "Path to the custom certificate bundle"
        help
            Path to the custom certificate bundle file (PEM). This path is
            evaluated relative to the project root directory.

endmenu
```

## components/osal/ext-io/Kconfig.ext_io
```kconfig
menu "External I/O Configuration"
    menu "ESP-IDF"
        orsource "$IDF_PATH/examples/common_components/env_caps/$IDF_TARGET/Kconfig.env_caps"

        config OSAL_EXT_IO_ESP_UART_PORT_NUM
            int "UART port number"
            range 0 2 if IDF_TARGET_ESP32 || IDF_TARGET_ESP32S3
            range 0 1
            default 0
            help
                UART communication port number to use.
                This should typically be set to 0 to use the same UART as the console monitor.
                See UART documentation for available port numbers.

        config OSAL_EXT_IO_ESP_UART_BAUD_RATE
            int "UART communication speed"
            range 1200 4000000 if !PM_ENABLE
            range 1200 1000000 if PM_ENABLE
            default ESP_CONSOLE_UART_BAUDRATE if OSAL_EXT_IO_ESP_UART_PORT_NUM = 0
            default 115200
            help
                UART communication speed to use.

        config OSAL_EXT_IO_ESP_UART_BUFFER_SIZE
            int "UART buffer size"
            range 128 1024
            default 256
            help
                UART buffer size to use.

        config OSAL_EXT_IO_ESP_UART_RXD
            depends on OSAL_EXT_IO_ESP_UART_PORT_NUM != 0
            int "UART RXD pin number"
            range ENV_GPIO_RANGE_MIN ENV_GPIO_IN_RANGE_MAX
            default 5
            help
                GPIO number for UART RX pin. See UART documentation for more information
                about available pin numbers for UART.

        config OSAL_EXT_IO_ESP_UART_TXD
            depends on OSAL_EXT_IO_ESP_UART_PORT_NUM != 0
            int "UART TXD pin number"
            range ENV_GPIO_RANGE_MIN ENV_GPIO_OUT_RANGE_MAX
            default 4
            help
                GPIO number for UART TX pin. See UART documentation for more information
                about available pin numbers for UART.
    endmenu

endmenu
```

## components/osal/http/test-http-common/Kconfig
```kconfig
menu "(test-http-common) HTTP Common Test Configuration"
    config TEST_HTTP_COMMON_URL_TCP
        string "Base URL (plain HTTP)"
        default "http://eu.httpbin.org"
        help
            Base URL of the plain-HTTP test server (no TLS). Tests append endpoint
            paths (/get, /post, ...). Defaults to the public httpbin.org service; CI
            overrides this to a local httpbin sidecar (see README) because the public
            service rate-limits and 503s, which made the tests flaky.

    config TEST_HTTP_COMMON_URL_TLS
        string "Base URL (HTTPS/TLS)"
        default "https://httpbin.org"
        help
            Base URL of the TLS test server. Tests append endpoint paths (/get, /post, ...).
            Defaults to the public httpbin.org service; CI overrides this to a local
            httpbin sidecar (see README) whose self-signed certificate is trusted via
            the POSIX CA bundle, so server verification still runs.
endmenu
```

## components/osal/mqtt/Kconfig.mqtt
```kconfig
menu "MQTT Common Interface"

    choice OSAL_MQTT_IMPL
        bool "MQTT Implementation"
        default OSAL_MQTT_IMPL_CORE

        help
            Choose backend MQTT library used.

            Defaults to CoreMQTT.

        config OSAL_MQTT_IMPL_CORE
            bool "CoreMQTT"

        config OSAL_MQTT_IMPL_ESP
            depends on IDF_CMAKE
            bool "esp-mqtt"
    endchoice

    config OSAL_MQTT_FORCE_USE_CERTIFICATE_BUNDLE
        bool
        default y
        select MBEDTLS_CERTIFICATE_BUNDLE if IDF_CMAKE
        help
            Force the use of the certificate bundle.

    # Common Parameters
    config OSAL_MQTT_SUBSCRIPTION_MANAGER_MAX_SUBSCRIPTIONS
        int "Maximum number of subscriptions tracked by subscription manager"
        default 10
        help
            A subscription manager is used to match incoming publishes with previously subscribed topic
            filters and their callbacks.
            This number specifies the maximum number of actively tracked topic filters.

    config OSAL_MQTT_RESUBSCRIBE_ON_CLEAN_SESSION
        bool "Resubscribe on clean session"
        default n
        help
            If set, the MQTT client will resubscribe to all previously subscribed topics
            when the MQTT client reconnects to the broker with a clean session.
            Otherwise, the subscription manager will be reset on every clean session, and
            all subscriptions will have to be added again.

    config OSAL_MQTT_MAX_IN_BUFFER_SIZE
        int
        default OSAL_MQTT_CORE_NETWORK_BUFFER_SIZE if OSAL_MQTT_IMPL_CORE
        default OSAL_MQTT_ESP_NETWORK_BUFFER_SIZE_IN if OSAL_MQTT_IMPL_ESP

    config OSAL_MQTT_AGENT_TASK_STACK_SIZE
        int "Agent task stack size"
        default 8192 if RMNG_BRIDGE_ENABLED
        default 4096
        help
            The stack size of the agent task.

    config OSAL_MQTT_AGENT_TASK_PRIORITY
        int "Agent task priority"
        default 4
        help
            The priority of the agent task.

    config OSAL_MQTT_KEEP_ALIVE_INTERVAL_S
        int "Keep alive interval (s)"
        range 40 1200
        default 40
        help
            The keep alive interval (in seconds) for the MQTT client.

            While the AWS IoT bounds are 30-1200 seconds, the lower bound is set
            to 40 seconds to avoid spurious disconnect events that occur too close to
            the actual AWS IoT lower bound.

            Higher values reduce wakeups/traffic, at the expense of slower
            disconnect detection.

    # CoreMQTT Specific Parameters
    menu "CoreMQTT Specific Parameters"
        depends on OSAL_MQTT_IMPL_CORE

        config OSAL_MQTT_CORE_NETWORK_BUFFER_SIZE
            int "Network buffer size"
            default 3072 if IDF_TARGET_ESP32C2
            default 8192 if RMNG_BRIDGE_ENABLED
            default 4096
            help
                The size of the network buffer used by CoreMQTT.

        config OSAL_MQTT_CORE_COMMAND_QUEUE_LENGTH
            int "Command queue length"
            default MQTT_AGENT_COMMAND_POOL_SIZE
            help
                The length of the command queue used by CoreMQTT.

        config OSAL_MQTT_CORE_CONNACK_RECV_TIMEOUT_MS
            int "Connack recv timeout"
            default 10000
            help
                The timeout for receiving CONNACK after sending an MQTT CONNECT packet.

        config OSAL_MQTT_CORE_RETRY_MAX_BACKOFF_DELAY_MS
            int "Retry max backoff delay"
            default 5000
            help
                The maximum back-off delay (in milliseconds) for retrying failed operation with server.

        config OSAL_MQTT_CORE_RETRY_BACKOFF_BASE_MS
            int "Retry backoff base"
            default 500
            help
                The base back-off delay (in milliseconds) to use for network operation retry attempts.

        config OSAL_MQTT_CORE_FORCE_IPV4
            depends on !IDF_CMAKE
            bool "Force IPv4-only when connecting to the broker"
            default n
            help
                Resolve the broker hostname with AF_INET only (IPv4), skipping any IPv6
                (AAAA) addresses. Only effective for the POSIX coreMQTT transport.

                On hosts whose IPv6 egress is black-holed (e.g. some CI runners), an IPv6
                address returned first by getaddrinfo causes connect() to stall until the
                OS SYN timeout (~60s) before falling back to IPv4. Forcing IPv4 avoids the
                stall entirely. Leave disabled for normal builds.
    endmenu

    # esp-mqtt Specific Parameters
    menu "esp-mqtt Specific Parameters"
        depends on OSAL_MQTT_IMPL_ESP

        config OSAL_MQTT_ESP_NETWORK_BUFFER_SIZE_IN
            int "Network buffer size (in)"
            default 3072 if IDF_TARGET_ESP32C2
            default 8192 if RMNG_BRIDGE_ENABLED
            default 4096
            help
                The size of the in network buffer used by esp-mqtt.

        config OSAL_MQTT_ESP_NETWORK_BUFFER_SIZE_OUT
            int "Network buffer size (out)"
            default 3072 if IDF_TARGET_ESP32C2
            default 8192 if RMNG_BRIDGE_ENABLED
            default 4096
            help
                The size of the out network buffer used by esp-mqtt.

        config OSAL_MQTT_ESP_CALLBACK_REGISTRY_SIZE
            int "Callback registry size"
            default 10
            help
                The size (number of entries) of the callback registry used by esp-mqtt.

        config OSAL_MQTT_ESP_OUTBOX_LIMIT
            int "Outbox limit"
            default 0
            help
                The limit of the outbox (in bytes) used by esp-mqtt. 0 for no limit.

        config OSAL_MQTT_ESP_RECONNECT_TIMEOUT_MS
            int "Reconnect timeout (ms)"
            default 10000
            help
                Reconnect to the broker after this value in milliseconds if the connection is lost.

        config OSAL_MQTT_ESP_NETWORK_TIMEOUT_MS
            int "Network timeout (ms)"
            default 10000
            help
                The timeout (in milliseconds) for network operations.
                Network operations are aborted if unsuccessful after this timeout.
    endmenu

endmenu
```
